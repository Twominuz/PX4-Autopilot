## src/examples/new_work_item/Kconfig
```kconfig
menuconfig EXAMPLES_NEW_WORK_ITEM
	bool "new_work_item"
	default n
	---help---
		Enable support for new_work_item
```

## src/examples/px4_pose_app/Kconfig
```kconfig
menuconfig EXAMPLES_PX4_POSE_APP
	bool "px4_pose_app"
	default n
	---help---
		Enable support for px4_pose_app
```

## src/examples/px4_twomsg_app/Kconfig
```kconfig
menuconfig EXAMPLES_PX4_TWOMSG_APP
	bool "px4_twomsg_app"
	default n
	---help---
		Enable support for px4_twomsg_app
```
